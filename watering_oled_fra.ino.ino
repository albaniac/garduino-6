/* @file CustomKeypad.pde
|| @version 1.0
|| @author Alexander Brevig
|| @contact alexanderbrevig@gmail.com
||
|| @description
|| | Demonstrates changing the keypad size and key values.
|| #
*/
#include <Keypad.h>

const byte ROWS = 4; //four rows
const byte COLS = 4; //four columns
//define the cymbols on the buttons of the keypads
char hexaKeys[ROWS][COLS] = {
  {'1','3','A','2'},
  {'4','6','B','5'},
  {'7','9','C','8'},
  {'*','#','D','0'}
};
byte rowPins[ROWS] = {9,8,7,6}; //connect to the row pinouts of the keypad
byte colPins[COLS] = {5,4,3,2}; //connect to the column pinouts of the keypad

//initialize an instance of class NewKeypad
Keypad customKeypad = Keypad( makeKeymap(hexaKeys), rowPins, colPins, ROWS, COLS); 

// define the pin that control the relay
#define RELAY1  11  

//initializing the OLED display
#include <SPI.h>
#include <Wire.h>
#include <Adafruit_GFX.h>
#include <Adafruit_SSD1306.h>

#define OLED_RESET 4
Adafruit_SSD1306 display(OLED_RESET);

#define NUMFLAKES 10
#define XPOS 0
#define YPOS 1
#define DELTAY 2


#define LOGO16_GLCD_HEIGHT 16 
#define LOGO16_GLCD_WIDTH  16 
static const unsigned char PROGMEM logo16_glcd_bmp[] =
{ B00000000, B11000000,
  B00000001, B11000000,
  B00000001, B11000000,
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  B00000000, B00110000 };

#if (SSD1306_LCDHEIGHT != 64)
#error("Height incorrect, please fix Adafruit_SSD1306.h!");
#endif

//LOGO
#define CAMEO16_GLCD_HEIGHT 64
#define CAMEO16_GLCD_WIDTH 128 

static const unsigned char PROGMEM skull[] = {
  // 's, 128x64px
  0xff, 0xff, 0xff, 0xff, 0xff, 0xff, 0xf0, 0xff, 0xff, 0xff, 0xff, 0xff, 0xff, 0xff, 0xff, 0xff, 
  0xff, 0xff, 0xff, 0xff, 0xdf, 0xff, 0x00, 0xff, 0xff, 0xff, 0xff, 0xff, 0xff, 0xff, 0xff, 0xff, 
  0xff, 0xff, 0xff, 0xff, 0x1f, 0xf8, 0x31, 0xff, 0xff, 0xff, 0xff, 0xff, 0xff, 0xff, 0xff, 0xff, 
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  0xff, 0xf8, 0x00, 0x00, 0xff, 0xff, 0xff, 0xff, 0xff, 0xff, 0xff, 0xff, 0xff, 0xff, 0xff, 0xff
};
 
static const unsigned char PROGMEM ganesh[] =
{ 0xff, 0xff, 0xff, 0xff, 0xff, 0xff, 0xff, 0xff, 0xff, 0xff, 0xff, 0xff, 0xff, 0xff, 0xff, 0xff, 
  0xff, 0xff, 0xff, 0xff, 0xff, 0xff, 0xff, 0xff, 0xff, 0xff, 0xff, 0xff, 0xff, 0xff, 0xff, 0xff, 
  0xff, 0xff, 0xff, 0xff, 0xff, 0xff, 0xff, 0xff, 0xff, 0xff, 0xff, 0xff, 0xff, 0xff, 0xff, 0xff, 
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  0xff, 0xff, 0xff, 0xff, 0xff, 0xff, 0xff, 0xff, 0xff, 0xff, 0xff, 0xff, 0xff, 0xff, 0xff, 0xff };


   

//Initializig DS3231 clock
#include "Wire.h"
#define DS3231_I2C_ADDRESS 0x68
// Convert normal decimal numbers to binary coded decimal
byte decToBcd(byte val)
{
  return( (val/10*16) + (val%10) );
}
// Convert binary coded decimal to normal decimal numbers
byte bcdToDec(byte val)
{
  return( (val/16*10) + (val%16) );
}

void setup(){
 //INITIALIZE OLED SCREEN
  Serial.begin(9600);
  // by default, we'll generate the high voltage from the 3.3v line internally! (neat!)
  display.begin(SSD1306_SWITCHCAPVCC, 0x3C);  // initialize with the I2C addr 0x3D (for the 128x64)
  display.display(); 
  delay(2000); 
  display.clearDisplay();
 
  //INITIALIZE RELAY 
  pinMode(RELAY1, OUTPUT); 
  digitalWrite(RELAY1,1);

  //INITIALIZE CLOCK
  // set the initial time here:
  //DS3231 seconds, minutes, hours, day, date, month, year
  //setDS3231time(00,00,17,2,28,05,18);
}

int h;
int m;
int wat_time = 17;
int dur = 5;

void loop(){
  char k = customKeypad.getKey();

  
//IF for changing watering time
if( k == 'A' ){
    Serial.println(k);
    
    for (int i=1; i <=2 ; i++){
      
      if(i==1){
        char n = customKeypad.waitForKey();
        h = n - '0';
        Serial.println(h);
        }
      if(i==2){
        char d = customKeypad.waitForKey();
        m = d-'0';
        Serial.println(m);
        } 
       wat_time = h*10+m;
    Serial.println(wat_time);    
    }
    wat_time = h*10+m;
    Serial.println(wat_time);  
  }

  
// if for changing watering duration
if( k == 'B' ){
    Serial.println(k);
    for (int i=1; i <=1 ; i++){
      char d = customKeypad.waitForKey();
      dur = d-'0';
      Serial.println(dur);
        } 
      }      
  
int h1;
int h2;
int m1;
int m2;
int d1;
int d2;
int mo1;
int mo2;
int y1;
int y2; 
if( k == 'C' ){
    Serial.println(k);
    byte second, minute, hour, dayOfWeek, dayOfMonth, month, year;   
    readDS3231time(&second, &minute, &hour, &dayOfWeek, &dayOfMonth, &month,
    &year);
    for (int i=1; i <=10 ; i++){
      
      if(i==1){
        char f = customKeypad.waitForKey();
        h1 = f - '0';
        Serial.println(h);
        }
      if(i==2){
        char f = customKeypad.waitForKey();
        h2 = f-'0';
        Serial.println(m);
        }
      if(i==3){
        char f = customKeypad.waitForKey();
        m1 = f-'0';
        Serial.println(m);
        } 
      if(i==4){
        char f = customKeypad.waitForKey();
        m2 = f-'0';
        Serial.println(m);
        }
        if(i==5){
        char f = customKeypad.waitForKey();
        d1 = f-'0';
        Serial.println(m);
        }
        if(i==6){
        char f = customKeypad.waitForKey();
        d2 = f-'0';
        Serial.println(m);
        }
        if(i==8){
        char f = customKeypad.waitForKey();
        mo1 = f-'0';
        Serial.println(m);
        }
        if(i==9){
        char f = customKeypad.waitForKey();
        mo2 = f-'0';
        Serial.println(m);
        }
        if(i==10){
        char f = customKeypad.waitForKey();
        y1 = f-'0';
        Serial.println(m);
        }
        if(i==10){
        char f = customKeypad.waitForKey();
        y2 = f-'0';
        Serial.println(m);
        }
       
   
    }
    hour = h1*10+h2;
    minute = m1*10+m2;
    dayOfMonth = d1*10+d2;
    month = mo1*10+mo2;
    year = y1*10+y2;
    //DS3231 seconds, minutes, hours, day, date, month, year
    setDS3231time(00,minute,hour,0,dayOfMonth,month,year);
  }

if( k == 'D' ){
  Serial.println(k);
  display.clearDisplay();
  display.setTextSize(3);
  display.setTextColor(WHITE);
  display.setCursor(0,0);
  display.print("Cazzo");
  display.setCursor(0,35);
  display.print("premi?");
  display.display();
  delay(2000);
      }
if( k == '#' ){
  Serial.println(k);
  display.clearDisplay();
  // below first two number equals stating pixel point,the three numbers next to logoname represent width, height and rotation
  display.drawBitmap(0, 0,  ganesh, 128, 64, 1);
  display.display();
  delay(2000);
      } 
if( k == '*' ){
  Serial.println(k);
  display.clearDisplay();
  // below first two number equals stating pixel point,the three numbers next to logoname represent width, height and rotation
  display.drawBitmap(0, 0,  skull, 128, 64, 1);
  display.display();
  water_plants(dur);  
      } 
  
  
  displayTime(wat_time, dur); 
  byte second, minute, hour, dayOfWeek, dayOfMonth, month, year;   
  readDS3231time(&second, &minute, &hour, &dayOfWeek, &dayOfMonth, &month,
  &year);
  //Serial.println(second);
  if( hour == wat_time and minute == 0 and second == 3 ){
    water_plants(dur);
    delay(1000);
  }
  delay(100);
  //water_plants(dur);
}


// define watering function that waters for "dur" seconds
// how long to water is set by variable "dur", default is 8 seconds
void water_plants(int dur){
   digitalWrite(RELAY1,0);          // Turns ON Relays 1
   Serial.println(dur);
   delay(dur*1000);                     // Wait 2 seconds

   digitalWrite(RELAY1,1);          // Turns Relay Off
   delay(100);
}

//Functions for the clock
void setDS3231time(byte second, byte minute, byte hour, byte dayOfWeek, byte
dayOfMonth, byte month, byte year)
{
  // sets time and date data to DS3231
  Wire.beginTransmission(DS3231_I2C_ADDRESS);
  Wire.write(0); // set next input to start at the seconds register
  Wire.write(decToBcd(second)); // set seconds
  Wire.write(decToBcd(minute)); // set minutes
  Wire.write(decToBcd(hour)); // set hours
  Wire.write(decToBcd(dayOfWeek)); // set day of week (1=Sunday, 7=Saturday)
  Wire.write(decToBcd(dayOfMonth)); // set date (1 to 31)
  Wire.write(decToBcd(month)); // set month
  Wire.write(decToBcd(year)); // set year (0 to 99)
  Wire.endTransmission();
}
void readDS3231time(byte *second,
byte *minute,
byte *hour,
byte *dayOfWeek,
byte *dayOfMonth,
byte *month,
byte *year)
{
  Wire.beginTransmission(DS3231_I2C_ADDRESS);
  Wire.write(0); // set DS3231 register pointer to 00h
  Wire.endTransmission();
  Wire.requestFrom(DS3231_I2C_ADDRESS, 7);
  // request seven bytes of data from DS3231 starting from register 00h
  *second = bcdToDec(Wire.read() & 0x7f);
  *minute = bcdToDec(Wire.read());
  *hour = bcdToDec(Wire.read() & 0x3f);
  *dayOfWeek = bcdToDec(Wire.read());
  *dayOfMonth = bcdToDec(Wire.read());
  *month = bcdToDec(Wire.read());
  *year = bcdToDec(Wire.read());
}

void displayTime(int wat_time, int dur)
{
  byte second, minute, hour, dayOfWeek, dayOfMonth, month, year;
  // retrieve data from DS3231
  readDS3231time(&second, &minute, &hour, &dayOfWeek, &dayOfMonth, &month,
  &year);

  display.clearDisplay();
  display.setTextSize(1);
  display.setTextColor(WHITE);
  display.setCursor(0,40);
  display.print("Watering at "+ String(wat_time) + "h for " + String(dur)+ " seconds");
  display.setTextSize(2);
  display.setCursor(0,00);
  display.print(hour, DEC);
  // convert the byte variable to a decimal number when displayed
  display.print(":");
  if (minute<10)
  {
    display.print("0");
  }
  display.print(minute, DEC);
  display.print(" ");
  switch(dayOfWeek){
  case 1:
    display.print("Sun");
    break;
  case 2:
    display.print("Mon");
    break;
  case 3:
    display.print("Tue");
    break;
  case 4:
    display.print("Wed");
    break;
  case 5:
    display.print("Thu");
    break;
  case 6:
    display.print("Fr");
    break;
  case 7:
    display.print("Sat");
    break;
  }
  display.setCursor(0,20);
  display.print(dayOfMonth, DEC);
  display.print("/");
  display.print(month, DEC);
  display.print("/");
  display.print(year, DEC);
  display.display();

  
  
}

